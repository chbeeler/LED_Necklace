//@cliArgs --device "MSPM0C110X" --package "VSSOP-20(DGS20)" --part "Default"
//@v2CliArgs --device "MSPM0C1104" --package "VSSOP-20(DGS20)"
// @cliArgs --board /ti/boards/LP_MSPM0C1104 --rtos nortos

/**
 * Import the modules used in this configuration.
 */
const Board = scripting.addModule("/ti/driverlib/Board");
const SYSCTL = scripting.addModule("/ti/driverlib/SYSCTL");
const ADC12  = scripting.addModule("/ti/driverlib/ADC12", {}, false);
const ADC121 = ADC12.addInstance();
const TIMER  = scripting.addModule("/ti/driverlib/TIMER", {}, false);
const TIMER1 = TIMER.addInstance();

/**
 * Write custom configuration values to the imported modules.
 */
ADC121.$name                      = "ADC12_0";
ADC121.sampClkSrc                 = "DL_ADC12_CLOCK_ULPCLK";
ADC121.sampClkDiv                 = "DL_ADC12_CLOCK_DIVIDE_8";
ADC121.resolution                 = "DL_ADC12_SAMP_CONV_RES_12_BIT";
ADC121.adcMem0chansel             = "DL_ADC12_INPUT_CHAN_2";
ADC121.powerDownMode              = "DL_ADC12_POWER_DOWN_MODE_MANUAL";
ADC121.adcMem0trig                = "DL_ADC12_TRIGGER_MODE_TRIGGER_NEXT";
ADC121.repeatMode                 = true;
ADC121.sampleTime0                = "5 us";
ADC121.enabledInterrupts          = ["DL_ADC12_INTERRUPT_MEM0_RESULT_LOADED",
                                     "DL_ADC12_INTERRUPT_OVERFLOW", "DL_ADC12_INTERRUPT_TRIG_OVF"];
ADC121.subChanID                  = 1;
ADC121.trigSrc                    = "DL_ADC12_TRIG_SRC_EVENT";
ADC121.peripheral.$assign         = "ADC0";
ADC121.peripheral.adcPin2.$assign = "PA25";

TIMER1.$name                       = "TIMER_0";
TIMER1.timerClkSrc                 = "BUSCLK";
TIMER1.timerMode                   = "PERIODIC";
TIMER1.timerPeriod                 = "62.5 us";
TIMER1.event1PublisherChannel      = 1;
TIMER1.event1ControllerInterruptEn = ["ZERO_EVENT"];
TIMER1.peripheral.$assign          = "TIMG14";

const GPIO = scripting.addModule("/ti/driverlib/GPIO", {}, false);
const leds = GPIO.addInstance();
leds.$name = "GPIO_LEDS";
leds.associatedPins.create(1);
leds.associatedPins[0].$name = "USER_LED";
leds.associatedPins[0].initialValue = "SET";
leds.associatedPins[0].assignedPin = "22";
